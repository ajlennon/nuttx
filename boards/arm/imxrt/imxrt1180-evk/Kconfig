## boards/arm/imxrt/imxrt1180-evk/Kconfig
```kconfig
#
# SPDX-License-Identifier: Apache-2.0
#

if ARCH_BOARD_IMXRT1180_EVK

config IMXRT1180_EVK_DTCM
	bool
	default y

config IMXRT1180_EVK_ROM_RAMLOAD
	bool "Create a FlexSPI NOR ROM RAM-load image"
	depends on BOOT_RUNFROMISRAM
	---help---
		Build an RT1180 container image for the Boot ROM to copy from
		FlexSPI NOR into CM33 ITCM.  Writable data remains in OCRAM.

		This option only creates the bootable image layout.  Programming
		the external flash still requires a suitable flash tool.

endif
```

## boards/arm/imxrt/imxrt1180-evk/configs/nsh/defconfig
```kconfig
#
# SPDX-License-Identifier: Apache-2.0
#

# CONFIG_ARCH_RAMFUNCS is not set
# CONFIG_NSH_DISABLE_DATE is not set
# CONFIG_NSH_DISABLE_MB is not set
# CONFIG_NSH_DISABLE_MH is not set
# CONFIG_NSH_DISABLE_MW is not set
CONFIG_ARCH="arm"
CONFIG_ARCH_BOARD="imxrt1180-evk"
CONFIG_ARCH_BOARD_IMXRT1180_EVK=y
CONFIG_ARCH_CHIP="imxrt"
CONFIG_ARCH_CHIP_IMXRT=y
CONFIG_ARCH_CHIP_MIMXRT1189=y
CONFIG_ARCH_STACKDUMP=y
CONFIG_BINFMT_DISABLE=y
CONFIG_BOARD_LOOPSPERMSEC=24000
CONFIG_BOOT_RUNFROMISRAM=y
CONFIG_BUILTIN=y
CONFIG_IDLETHREAD_STACKSIZE=2048
CONFIG_IMXRT_LPUART1=y
CONFIG_INIT_ENTRYPOINT="nsh_main"
CONFIG_INTELHEX_BINARY=y
CONFIG_LIBC_LOCALTIME=y
CONFIG_LINE_MAX=64
CONFIG_LPUART1_BAUD=115200
CONFIG_LPUART1_SERIAL_CONSOLE=y
CONFIG_NSH_BUILTIN_APPS=y
CONFIG_NSH_DISABLE_IFUPDOWN=y
CONFIG_NSH_FILEIOSIZE=512
CONFIG_NSH_READLINE=y
CONFIG_RAM_SIZE=524288
CONFIG_RAM_START=0x20480000
CONFIG_RAW_BINARY=y
CONFIG_SCHED_BACKTRACE=y
CONFIG_START_DAY=15
CONFIG_START_MONTH=8
CONFIG_SYSTEM_NSH=y
```
